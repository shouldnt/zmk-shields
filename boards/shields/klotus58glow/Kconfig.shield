## boards/shields/klotus58glow/Kconfig.shield
```kconfig
# Copyright (c) 2020 Pete Johanson
# SPDX-License-Identifier: MIT

config SHIELD_KLOTUS58GLOW_LEFT
    def_bool $(shields_list_contains,klotus58glow_left)

config SHIELD_KLOTUS58GLOW_RIGHT
    def_bool $(shields_list_contains,klotus58glow_right)
```
