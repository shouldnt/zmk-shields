## boards/shields/kmouse/Kconfig.defconfig
```kconfig
# Copyright (c) 2020 The ZMK Contributors
# SPDX-License-Identifier: MIT

if SHIELD_KMOUSE

config ZMK_KEYBOARD_NAME
    default "kmouse"

config ZMK_POINTING
    default y

config SPI
    default y

endif
```

## boards/shields/neurophante/Kconfig.shield
```kconfig
# Copyright (c) 2020 Ryan Cross
# SPDX-License-Identifier: MIT

config SHIELD_NEUROPHANTE_LEFT
    def_bool $(shields_list_contains,neurophante_left)

config SHIELD_NEUROPHANTE_RIGHT
    def_bool $(shields_list_contains,neurophante_right)
```
