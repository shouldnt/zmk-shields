/*
 * Copyright (c) 2020 The ZMK Contributors
 *
 * SPDX-License-Identifier: MIT
 */
 #include <behaviors.dtsi>
#include <dt-bindings/zmk/keys.h>
#include <dt-bindings/zmk/bt.h>
#include <dt-bindings/zmk/pointing.h>

#define DEFAULT_LAYER 0
#define R_LAYER 1
#define L_LAYER 2
#define T_LAYER 3

#define COMBO_TIMEOUT 50

#define THUMB_L_CLOSE 13
#define THUMB_L_FAR 14 
#define THUMB_R_CLOSE 16
#define THUMB_R_FAR 15

/ {
    keymap {
        compatible = "zmk,keymap";
        default_layer {
            bindings = <&mmv MOVE_UP>;
        };
    };
};